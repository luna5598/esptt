## main/Kconfig.projbuild
```kconfig
menu "MO companion board"
config MOBAN_LIMB_BUS
    bool "Enable wired TCA9546A limb bus"
    default n
if MOBAN_LIMB_BUS
config MOBAN_SDA
    int "Limb SDA GPIO"
    default -1
config MOBAN_SCL
    int "Limb SCL GPIO"
    default -1
config MOBAN_MUX_RESET
    int "Active-low TCA9546A RESET GPIO"
    default -1
config MOBAN_MUX_ADDRESS
    hex "TCA9546A 7-bit address"
    range 0x70 0x77
    default 0x70
config MOBAN_SLOT_0_EN
    int "CH0 slot power enable GPIO (-1 for externally powered)"
    default -1
config MOBAN_SLOT_1_EN
    int "CH1 slot power enable GPIO (-1 for externally powered)"
    default -1
config MOBAN_SLOT_2_EN
    int "CH2 slot power enable GPIO (-1 for externally powered)"
    default -1
config MOBAN_SLOT_3_EN
    int "CH3 slot power enable GPIO (-1 for externally powered)"
    default -1
config MOBAN_SLOT_EN_LOW
    bool "Slot power enable pins are active-low"
    default n
endif
endmenu
```

## profiles/voice/moban_voice/Kconfig
```kconfig
menu "MO companion offline voice"
config MOBAN_OFFLINE_VOICE
    bool
    default y

config MOBAN_VOICE_BCLK
    int "I2S microphone bit clock GPIO"
    default -1

config MOBAN_VOICE_WS
    int "I2S microphone word select GPIO"
    default -1

config MOBAN_VOICE_DIN
    int "I2S microphone data input GPIO"
    default -1

config MOBAN_VOICE_SLOT
    int "Preferred limb slot when multiple sensors of the requested type are present"
    range 0 3
    default 0
endmenu
```

## profiles/voice/sdkconfig.defaults
```kconfig
CONFIG_IDF_TARGET="esp32s31"
CONFIG_ESPTOOLPY_FLASHSIZE_16MB=y
CONFIG_PARTITION_TABLE_CUSTOM=y
CONFIG_PARTITION_TABLE_CUSTOM_FILENAME="partitions.csv"
CONFIG_SPIRAM=y
CONFIG_ESP_MAIN_TASK_STACK_SIZE=8192
CONFIG_MODEL_IN_FLASH=y
CONFIG_SR_WN_WN9_HILEXIN=y
CONFIG_SR_MN_CN_MULTINET7_QUANT=y
```
